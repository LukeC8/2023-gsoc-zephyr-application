## Kconfig
```kconfig
# SPDX-License-Identifier: Apache-2.0

menu "Zephyr"
source "Kconfig.zephyr"
endmenu

module = APP
module-str = BASIC_HTTP_SERVER
source "subsys/logging/Kconfig.template.log_config"
```
